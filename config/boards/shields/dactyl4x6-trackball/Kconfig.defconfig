## config/boards/shields/dactyl4x6-trackball/Kconfig.defconfig
```kconfig
if SHIELD_DACTYL4X6_LEFT

config ZMK_KEYBOARD_NAME
  default "Dactyl4x6"

config ZMK_SPLIT_ROLE_CENTRAL
  default y

endif

if SHIELD_DACTYL4X6_LEFT || SHIELD_DACTYL4X6_TRACKBALL_RIGHT

config ZMK_SPLIT
  default y

if ZMK_DISPLAY

config I2C
  default y

config SSD1306
  default y

endif # ZMK_DISPLAY

if LVGL

config LV_Z_VDB_SIZE
    default 64

config LV_DPI_DEF
    default 148

config LV_Z_BITS_PER_PIXEL
    default 1

choice LV_COLOR_DEPTH
    default LV_COLOR_DEPTH_1
endchoice

endif # LVGL

endif 

if SHIELD_DACTYL4X6_TRACKBALL_RIGHT

config ZMK_POINTING
    default y

config ADNS9800
    default y

config SPI
    default y

endif
```

## config/boards/shields/dactyl4x6-trackball/Kconfig.shield
```kconfig
config SHIELD_DACTYL_LEFT
  def_bool $(shields_list_contains,dactyl4x6_left)


config SHIELD_DACTYL_RIGHT
  def_bool $(shields_list_contains,dactyl4x6_trackball_right)
```

## config/west.yml
```yaml
manifest:
  remotes:
    - name: zmkfirmware
      url-base: https://github.com/petejohanson
    # Additional modules containing boards/shields/custom code can be listed here as well
    # See https://docs.zephyrproject.org/3.2.0/develop/west/manifest.html#projects
    - name: badjeff
      url-base: https://github.com/badjeff

  projects:
    - name: zmk
      remote: zmkfirmware
      revision: feat/pointers-move-scroll
      import: app/west.yml
    - name: zmk-adns9800-driver
      remote: badjeff
      revision: main
  self:
    path: config
```
